					  LCD EQU 1000H 
DIPSW EQU 4000H
EN BIT P3.4
RS BIT P3.5
THU_TU_PHIM EQU 30H
MACOT EQU 31H
CHONG_RUNG EQU 32H
TEMP EQU 33H
DULIEU EQU 40H
;****************************************************************
;CHUONG TRINH CHINH *********************************************
ORG 0000H
CALL KHOIDONG
CALL CLEAR_LCD
CALL WELCOME
MAIN:
CALL DOCPHIMNHAN
CALL MODE

; CHON MODE	 *************************************************
MODE:
CALL DOC_MODE
JC MODE_CALC
JMP MODE_CHANGE
DOC_MODE:
CJNE A,#12,NOT_MODE1
SETB C 
RET 
NOT_MODE1:
CJNE A,#13,NOT_MODE2
CLR C
RET 
NOT_MODE2:
POP 7
POP 7 
POP 7
POP 7
JMP MAIN
; MODE CHANGE: CHUYEN SO NHI PHAN 8 BIT CO DAU RA LED 7
MODE_CHANGE:
CALL CLEAR_LCD
MOV 56H,#00H
MOV DPTR,#DIPSW
MOVX A,@DPTR
JB ACC.7,SOAM
SODUONG:
CALL BIN_TO_BCD
PUSH ACC 
MOV A,B
ADD A,#80H
MOV 53H,A
POP ACC 
CALL BIN_TO_BCD
PUSH ACC 
MOV A,B
ADD A,#40H
MOV 54H,A
POP ACC
ADD A,#20H
MOV 55H,A
HIENTHI:
MOV A,53H
CALL HIENLED
MOV A,54H
CALL HIENLED
MOV A,55H
CALL HIENLED
MOV A,56H
CALL HIENLED
MOV P1,#0EFH
JMP MODE_CHANGE
SOAM:
CPL A
ADD A,#1
MOV 56H,#1AH
JMP SODUONG
HIENLED:
MOV DPTR,#0000H
MOVX @DPTR,A
CALL DELAYLCD
RET
; MODE CALC: MODE TINH TOAN CONG TRU 2 SO CO 3 CHU SO 
MODE_CALC:
MOV 4DH,#00H	 
CALL CLEAR_LCD
MOV R1,#40H

; NHAP SO THU NHAT************************************
MOV R2,#3
NHAP1:	  
CALL DOCPHIMNHAN
CALL GIAIMA
MOV @R1,A
CALL WRITE_DATA
INC R1
DJNZ R2,NHAP1
; NHAP PHEP TINH**************************************** 
CALL PHEPTINH
CALL GIAIMA
CALL WRITE_DATA
;NHAP SO THU 2*******************************************
MOV R2,#3
NHAP2:
CALL DOCPHIMNHAN
CALL GIAIMA
MOV @R1,A
CALL WRITE_DATA
INC R1
DJNZ R2,NHAP2
;NHAP DAU BANG DE BAT DAU THUC HIEN TINH TOAN************
DAUBANG:
CALL DOCPHIMNHAN
CJNE A,#11,DAUBANG
CALL GIAIMA
CALL WRITE_DATA
; GOI CHUONG TRINH TINH TOAN VA IN RA KET QUA ************
CALL TINHTOAN
CALL KETQUA
MOV P1,#0EFH
JMP $ ;CHO NHAN NUT ON/C TREN BAN PHIM DE RESET**********

;CHUONG TRINH XU LY KET QUA TINH TOAN*********************
KETQUA:
MOV R1,#4DH
MOV A,@R1
CALL WRITE_DATA
MOV R1,#4EH
LOPP:
MOV A,@R1
ADD A,#30H
CALL WRITE_DATA
INC	R1
CJNE R1,#51H,LOPP
RET
;CHUONG TRINH TINH TOAN*************************************
TINHTOAN:
MOV A,46H
CJNE A,#0FFH,TINH_TRU
; BIEU THUC CONG*******************************************
TINH_CONG:
MOV A,42H
ANL A,#0FH
MOV B,45H
ANL B,#0FH
ADD A,B 
CALL BIN_TO_BCD
MOV 50H,B
ADD A,41H
ADD A,#-30H
ADD A,44H
ADD A,#-30H
CALL BIN_TO_BCD
MOV 4FH,B
ADD A,40H
ADD A,#-30H
ADD A,43H
ADD A,#-30H
CALL BIN_TO_BCD
MOV 4EH,B
ADD A,#30H
MOV 4DH,A
RET
;BIEU THUC TRU*******************************************
TINH_TRU:
MOV A,40H
MOV B,43H
CJNE A,B,KHACNHAU0 ; GOI CHUONG TRINH DAO DE TINH KET QUA CHO PHEP TRU KET QUA AM
KIEMTRA0:MOV A,41H
MOV B,44H
CJNE A,B,KHACNHAU1
KIEMTRA1:MOV A,42H
MOV B,45H
CJNE A,B,KHACNHAU2

THUAN:
MOV A,42H
MOV B,45H
CLR CY
SUBB A,B
JNB ACC.7,LUU0
ADD A,#0AH
SETB CY
LUU0:MOV 50H,A
MOV A,41H
MOV B,44H
SUBB A,B
JNB ACC.7,LUU1
ADD A,#0AH
SETB CY
LUU1:MOV 4FH,A
MOV A,40H
MOV B,43H
SUBB A,B
JNB ACC.7,LUU2
ADD A,#0AH
LUU2:MOV 4EH,A
RET
; CHUONG TRINH DAO DE THAY DOI O NHO LUU DU LIEU 
KHACNHAU0:
JNC THUAN
JMP DAO
KHACNHAU1:
JNC THUAN
JMP DAO
KHACNHAU2:
JNC THUAN
DAO:
JNC THUAN
MOV A,40H
MOV R1,#43H
XCH A,@R1
MOV 40H,A
MOV A,41H
MOV R1,#44H
XCH A,@R1
MOV 41H,A
MOV A,42H
MOV R1,#45H
XCH A,@R1
MOV 42H,A
MOV 4DH,#"-"
JMP THUAN
; CHUONG TRINH CHUYEN SO NHI PHAN SANG BCD
BIN_TO_BCD:
MOV B,#10
DIV AB 
MOV 51H,A
MOV 52H,B
RET
; CHUONG TRINH CHAO MUNG **************************************
WELCOME:
MOV R6,#0
CHAY:
MOV DPTR,#LOICHAO
MOV A,R6
MOVC A,@A+DPTR
CALL WRITE_DATA
INC R6
CJNE A,#00H,CHAY
RET

LOICHAO: DB "MOI CHON MODE",0
;CHUONG TRINH DOC PHIM NHAN TU BAN PHIM MA TRAN*****************
PHEPTINH:
CALL DOCPHIMNHAN
CALL DOC_PHEPTINH
JC CONG
JMP TRU
DOC_PHEPTINH:
CJNE A,#14,NOT_TRU
CLR C 
RET 
NOT_TRU:	; KHONG PHAI DAU TRU ********************************
CJNE A,#15,NOT_CONG
SETB C
RET 
NOT_CONG:	; KHONG PHAI DAU CONG********************************* 
POP 7
POP 7 
JMP PHEPTINH
; PHEP CONG**************************************************
CONG:
MOV A,#15
MOV 46H,#0FFH
RET
; PHEP TRU***************************************************
TRU:
MOV A,#14
MOV 46H,#00H
RET
; CHUONG TRINH DOC PHIM NHAN 
;****************************************************************
DOCPHIMNHAN:
MOV CHONG_RUNG,#50                   ;CHONG RUNG KHI NHAN PHIM
CHECK0:CALL CHECK_PHIM_NHAN               
JC DOCPHIMNHAN                     ;C = 1 LA KO CO PHIM NHAN
DJNZ CHONG_RUNG,CHECK0
MOV TEMP,A                         ;LUU TAM THU TU PHIM   
CHECK1:MOV CHONG_RUNG,#50                ;CHONG RUNG KHI NHA PHIM
CHECK2:CALL CHECK_PHIM_NHAN
JNC CHECK1                             ;C = 0 LA CO PHIM NHAN
DJNZ CHONG_RUNG,CHECK2
EXIT:
MOV A,TEMP
RET
GIAIMA:
MOV DPTR,#BUTTON
MOVC A,@A+DPTR
RET
;****************************************************************
CHECK_PHIM_NHAN:
MOV    THU_TU_PHIM,#0
MOV    MACOT,#0EFH            ;MA COT 1
XOAY:MOV    P1,MACOT
CALL DELAYFAST
MOV     A,P1
ANL      A,#0FH                      ;LAY MA HANG
CJNE    A,#0FH,LAPMA          ;KIEM TRA CO NHAN PHIM KO
;KHONG CO PHIM NHAN*************************************************
MOV     A,THU_TU_PHIM
ADD     A,#4
MOV     THU_TU_PHIM,A                  ;THU_TU_PHIM = THU_TU_PHIM + 4
MOV     A,MACOT           
RL      A                               ;DICH SANG COT KE
MOV     MACOT,A
CJNE    A,#0FEH,XOAY               ;KIEM TRA DA DICH DEN COT THU 4 CHUA ?
SETB    C                               ;KO CO PHIM BAM
RET
;CO PHIM NHAN ************************************************************
LAPMA:
RRC    A
JNC    LUU_THU_TU
INC    THU_TU_PHIM                      ;MA PHIM = MA PHIM + 1
JMP    LAPMA
LUU_THU_TU:MOV   A,THU_TU_PHIM                   ;DA CO PHIM AN
CLR     C
RET
;*************************************************************************
;BANG MA DE DOC BAN PHIM MA TRAN 
BUTTON:
DB 37H,34H,31H,"O"
DB 38H,35H,32H,30H
DB 39H,36H,33H,"="
DB "A","B","-","+"
; CHUONG TRINH KHOI DONG LCD*********************************************
KHOIDONG:
	MOV A, #38H
	CALL WRITE_LENH
	MOV A, #06H
	CALL WRITE_LENH
	MOV A, #0EH
	CALL WRITE_LENH
;	MOV A, #0CH
;	CALL WRITE_LENH
	RET
;CHUONG TRINH GUI LENH DEN LCD*******************************************
WRITE_LENH:
	MOV DPTR,#LCD
	MOVX @DPTR, A
	SETB EN
	CLR RS
	CLR EN
	CALL DELAYLCD
	RET
;CHUONG TRINH GUI DATA DEN LCD*******************************************
WRITE_DATA:
	MOV DPTR,#LCD
	MOVX @DPTR, A
	SETB EN
	SETB RS
	CLR EN
	CALL DELAYLCD
	RET
;CHUONG TRINH XOA LCD **************************************************
CLEAR_LCD:
MOV  A,#01H
CALL WRITE_LENH
RET
;CHUONG TRINH DELAY LCD *********************************************
DELAYLCD:
MOV TMOD ,#01H
MOV TH0,#HIGH(-2000)
MOV TL0,#LOW(-2000)
SETB TR0
JNB TF0,$
CLR TR0
CLR TF0
RET
DELAYFAST:
MOV TMOD ,#01H
MOV TH0,#HIGH(-50)
MOV TL0,#LOW(-50)
SETB TR0
JNB TF0,$
CLR TR0
CLR TF0
RET
END
;XONGGGGGGGGGGGGGGGGGGGGGGGGGGGG
